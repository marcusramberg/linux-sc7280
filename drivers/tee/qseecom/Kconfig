## drivers/tee/qseecom/Kconfig
```kconfig
# SPDX-License-Identifier: GPL-2.0-only
# Qualcomm QSEECOM TEE driver
config TEE_QSEECOM
	tristate "Qualcomm QSEECOM TEE driver"
	depends on QCOM_QSEECOM
	depends on !CPU_BIG_ENDIAN
	help
	  This exposes QSEE applications reached over the legacy QSEECOM
	  interface through the TEE subsystem, so that user space can open a
	  session to a trusted application and invoke commands in it.

	  This is the older, command-based Qualcomm interface, as distinct from
	  the object-based one served by the QCOMTEE driver. Platforms that
	  predate smcinvoke, or whose applications were built against QSEECOM,
	  need this one.
```
